## drivers/sensor/si7055/Kconfig
```kconfig
# Copyright (c) 2019 Electronut Labs
# Copyright (c) 2020 Laird Connectivity
# SPDX-License-Identifier: Apache-2.0

config SI7055
	bool "Si7055 Temperature Sensor"
	depends on (I2C && HAS_DTS_I2C)
	help
	  Enable I2C-based driver for Si7055 Temperature Sensor.
```
